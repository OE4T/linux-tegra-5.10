// SPDX-License-Identifier: GPL-2.0-only
/*
 * Device-tree overlay for ReSpeaker 4-Mic Array with board
 * tegra194-p2888-0001-p2822-0000.
 *
 * Copyright (c) 2020 NVIDIA CORPORATION. All rights reserved.
 *
 */

/dts-v1/;
/plugin/;

#include <dt-common/jetson/tegra194-p2888-0001-p2822-0000.h>
#include <overlays/jetson-respeaker-4-mic-array.dts>
