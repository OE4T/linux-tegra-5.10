/*
 * Copyright (c) 2020, NVIDIA CORPORATION.  All rights reserved.
 *
 * This program is free software; you can redistribute it and/or modify it
 * under the terms and conditions of the GNU General Public License,
 * version 2, as published by the Free Software Foundation.
 *
 * This program is distributed in the hope it will be useful, but WITHOUT
 * ANY WARRANTY; without even the implied warranty of MERCHANTABILITY or
 * FITNESS FOR A PARTICULAR PURPOSE.  See the GNU General Public License for
 * more details.
 *
 * You should have received a copy of the GNU General Public License
 * along with this program.  If not, see <http://www.gnu.org/licenses/>.
 */

/*
 * Device-tree overlay for tegra194-p2888-0004-e3900-0000 40-pin
 * Expansion Header.
 */

/dts-v1/;
/plugin/;

#include <dt-common/jetson/tegra194-p2888-0004-e3900-0000.h>
#include "../../galen/kernel-dts/tegra194-p2888-0001-p2822-0000-hdr40.dtsi"
