## drivers/pwm/Kconfig
```kconfig
if PWM
config PWM_TEGRA_TACHOMETER
	tristate "NVIDIA Tegra Tachometer PWM driver "
	depends on ARCH_TEGRA
	help
	  NVIDIA Tegra Tachometer reads the PWM signal and reports the PWM
	  signal periods. This helps in measuign the fan speed where Fan
	  output for speed is PWM signal.

	  This driver support the Tachometer driver in PWM framework.
endif
```

## drivers/video/tegra/Kconfig
```kconfig
if ARCH_TEGRA

config TEGRA_GRHOST_OFA
        depends on TEGRA_GRHOST
        bool "Tegra OFA support"
        default y
        help
          Driver for the Tegra OFA is an engine which
          can be used for optical flow/stereo acceleration.

endif
```

## sound/soc/Kconfig
```kconfig
if SND_SOC && ("$(VERSION)" < "5")

source "sound/soc/tegra-alt/Kconfig"
source "sound/soc/tegra-virt-alt/Kconfig"

endif
```
