## Documentation/devicetree/bindings/reserved-memory/tegra234-bpmp-shmem.txt
```
* Tegra CPU-NS - BPMP IPC reserved memory binding

Define a memory region used for communication between CPU-NS and BPMP.
Typically this node is created by the bootloader as the physical address
has to be known to both CPU-NS and BPMP for correct IPC operation.

The memory region is defined using a child node under /reserved-memory.
The sub-node is named shmem@<address> and has the following properties:

- compatible:
	compatible = "nvidia,tegra234-bpmp-shmem";

- reg:
	The physical address and size of the shared SDRAM region

- no-map:
	To prevent the OS from creating a virtual mapping for this region.
	(See reserved-memory.txt for details on the no-map property)

Example:

/ {
	reserved-memory {
		...
		dram_cpu_bpmp_mail: shmem@0xf1be0000  {
			compatible = "nvidia,tegra234-bpmp-shmem";
			reg = <0x0 0xf1be0000 0x0 0x2000>;
			no-map;
		};

		...
	};
};
```

## Documentation/devicetree/bindings/sound/nvidia,tegra210-dmic.yaml
```yaml
# SPDX-License-Identifier: (GPL-2.0)
%YAML 1.2
---
$id: http://devicetree.org/schemas/sound/nvidia,tegra210-dmic.yaml#
$schema: http://devicetree.org/meta-schemas/core.yaml#

title: NVIDIA Tegra210 DMIC Controller DT Bindings

description: |
  The Digital MIC (DMIC) Controller is used to interface with Pulse
  Density Modulation (PDM) input devices. It converts PDM signals to
  PCM (Pulse Coded Modulation) signals. DMIC can be viewed as a
  PDM receiver.

maintainers:
  - Jonathan Hunter <jonathanh@nvidia.com>
  - Sameer Pujar <spujar@nvidia.com>
  - Mohan Kumar D <mkumard@nvidia.com>

properties:
  compatible:
    oneOf:
      - items:
          description: for Tegra210 based platforms
          const: "nvidia,tegra210-dmic"

      - items:
          description: for Tegra186 based platforms
          const: "nvidia,tegra186-dmic", "nvidia,tegra210-dmic"

      - items:
          description: for Tegra194 based platforms
          const: "nvidia,tegra194-dmic", "nvidia,tegra210-dmic"

  reg:
    maxItems: 1
    description: Must contain physical base address and length of device's
      registers

  clocks:
    items:
      - description: Module clock

  clock-names:
    items:
      - const: dmic

  assigned-clocks:
    items:
      - description: Module clock

  assigned-clock-parents:
    items:
      - description: Parent for module clock

  assigned-clock-rates:
    items:
      - description: initial module clock rate

  "#sound-dai-cells":
    description: The cell specifies number of DAIs.
    const: 1

  nvidia,ahub-dmic-id:
    description: Must be specified to uniquely identify DMIC instance

required:
  - compatible
  - reg
  - clocks
  - clock-names
  - assigned-clocks
  - assigned-clock-parents
  - "#sound-dai-cells"

examples:
  - |
    dmic@702d4000 {
        compatible = "nvidia,tegra210-dmic";
        reg = <0x702d4000 0x100>;
        clocks = <&tegra_car TEGRA210_CLK_DMIC1>;
        clock-names = "dmic";
        assigned-clocks = <&tegra_car TEGRA210_CLK_DMIC1>;
        assigned-clock-parents = <&tegra_car TEGRA210_CLK_PLL_A_OUT0>;
        assigned-clock-rates = <3072000>;
        #sound-dai-cells = <1>;
        nvidia,ahub-dmic-id = <0>;
    };

  - |
    dmic@2904000 {
        compatible = "nvidia,tegra186-dmic", "nvidia,tegra210-dmic";
        reg = <0x0 0x2904000 0x0 0x100>;
        clocks = <&tegra_car TEGRA186_CLK_DMIC1>, <&tegra_car TEGRA186_CLK_PLL_A_OUT0>;
        clock-names = "dmic", "parent";
        assigned-clocks = <&tegra_car TEGRA186_CLK_DMIC1>;
        assigned-clock-parents = <&tegra_car TEGRA186_CLK_PLL_A_OUT0>;
        assigned-clock-rates = <3072000>;
        #sound-dai-cells = <1>;
        nvidia,ahub-dmic-id = <0>;
    };

  - |
    dmic@2904000 {
        compatible = "nvidia,tegra194-dmic", "nvidia,tegra210-dmic";
        reg = <0x0 0x2904000 0x0 0x100>;
        clocks = <&bpmp_clks TEGRA194_CLK_DMIC1>, <&bpmp_clks TEGRA194_CLK_PLLA_OUT0>;
        clock-names = "dmic", "parent";
        assigned-clocks = <&bpmp_clks TEGRA194_CLK_DMIC1>;
        assigned-clock-parents = <&bpmp_clks TEGRA194_CLK_PLLA_OUT0>;
        assigned-clock-rates = <3072000>;
        #sound-dai-cells = <1>;
        nvidia,ahub-dmic-id = <0>;
    };

...
```

## Documentation/devicetree/bindings/thermal/max77851_thermal.txt
```
Thermal driver for MAX77851 Power management IC from Maxim Semiconductor.


For more details, please refer generic thermal DT binding document
<devicetree/bindings/thermal/thermal.txt>.


Example:
--------
#include <dt-bindings/mfd/max77851.h>
#include <dt-bindings/thermal/thermal.h>
...

i2c1: i2c@7e804000 {
	max77851: max77851@3c {
		compatible = "maxim,max77851-pmic";
		:::::
		#thermal-sensor-cells = <0>;
		:::
	};
};

thermal-zones {
	pmic_thermal: pmic-thermal {
		polling-delay-passive = <0>;
		polling-delay = <1000>;
		thermal-sensors = <&max77851>;

		trips {
			pmic_die_warn_temp_thresh: hot-die {
				temperature = <120000>;
				type = "hot";
				hysteresis = <0>;
			};
			pmic_die_cirt_temp_thresh: cirtical-die {
				temperature = <140000>;
				type = "critical";
				hysteresis = <0>;
			};
		};
		cooling-maps {
		};
	};
};
```

## Documentation/devicetree/bindings/video/nvidia,tegra234-max-gmsl-dp-ser.txt
```
Maxim GMSL DP Serializer Driver

Required properties:
- compatible : should be "maxim,max_gmsl_dp_ser".
- reg : I2C address of the Maxim display serializer.
- max_gmsl_dp_ser-pwrdn : GPIO pin number of the PWRDN pin.
                          This is the pin that's used to power
                          up the Maxim display serializer chip.

Optional properties:
- dprx-link-rate : Configures the DP link rate of the serializer chip.
                   The default value is 0x1E (HBR3). The possible values are:
                   - 0xA (HBR),
                   - 0x14 (HBR2),
                   - 0x1E (HBR3).
- dprx-lane-count : Configures the DP lane count of the serializer chip.
                    The default value is 0x4. The possible values are:
                    - 0x1,
                    - 0x2,
                    - 0x4.
- gmsl-link-select : Determines which GMSL output link will be enabled.
                     The default value is 0x0 (Link A). The possible values are:
                     - 0x0 (Link A),
                     - 0x1 (Link B).
- ser-errb : GPIO pin number of the ERRB pin. This pin is used for error
             and fault reporting by the serializer chip.

Example:

	i2c@31e0000 {
		status = "okay";
		maxim_ser: max_gmsl_dp_ser@40 {
			compatible = "maxim,max_gmsl_dp_ser";
			reg = <0x40>;
			status = "okay";
			max_gmsl_dp_ser-pwrdn = <&tegra_main_gpio
							TEGRA234_MAIN_GPIO(G, 3)
							GPIO_ACTIVE_HIGH>;
			ser-errb = <&tegra_main_gpio TEGRA234_MAIN_GPIO(G, 7) 0>;
			dprx-link-rate = <0x1e>;
			dprx-lane-count = <0x4>;
			gmsl-link-select = <0x0>;
		};
	};
```

## Documentation/devicetree/bindings/video/nvidia,tegra_dc_common.txt
```
NVIDIA Tegra Display Controller

The Tegra Display Hardware (DC) provides an engine for display processing
pipeline with support of format conversion, scaling, rotation of display
content with supporting different protocols for display pipeline.

This tegra_dc_common node is used for mainly initializing chip-level information
about display HW, such as the total number of heads, windows, and SORs.
It is also used for retrieval of the static IMP table from device tree.
Rest of details for Tegra DC are given in ./nvidia,tegrat194-dc.txt

Required properties:
- compatible: Must be "nvidia,tegra_dc_common".
- reg: The physical base address and length of the address spaces for all heads.
  For T194, the physical base address should be that of HEAD0, and
  the length should be 0x40000 to cover HEAD0 - HEAD3.
- nvidia,valid_heads: This is a legacy property that is carried over from T186.
  It must be set to 0x0.
- nvidia,disp_imp_table: This table contains static IMP (Is Mode Possible)
  settings for different display configurations. IMP is essentially a SW/HW
  feature that programs display's bandwidth resources so that the display pipeline
  doesn't underflow.

Example:
=======

SoC DTSI:
--------

dc_common {
	compatible = "nvidia,tegra_dc_common";
	reg = <0x0 0x15200000 0x0 0x40000>;
	nvidia,valid_heads = <0x0>;
	nvidia,disp_imp_table = <&disp_imp_table>;
};
```

## arch/arm64/Kconfig
```kconfig
config ARCH_TEGRA_23x_SOC
	bool "Tegra 23x family SOC (Downstream options)"
	select PINCTRL
	default n
	help
	  NVIDIA Tegra Downstream options for 23x family of SoCs

config ARCH_TEGRA_239_SOC
	bool "Tegra 239 family SOC (Downstream options)"
	select PINCTRL
	default n
	help
	  NVIDIA Tegra Downstream options for 239 family of SoCs

config TEGRA_PSC
	tristate "NVIDIA Tegra Option for PSC module"
	depends on ARCH_TEGRA_23x_SOC
	default y
	help
	  Enable NVIDIA Tegra Option for platform security controller
```

## arch/arm64/configs/tegra_early_boot_defconfig
```kconfig
# CONFIG_LOCALVERSION_AUTO is not set
# CONFIG_SWAP is not set
CONFIG_SYSVIPC=y
CONFIG_POSIX_MQUEUE=y
CONFIG_AUDIT=y
CONFIG_NO_HZ=y
CONFIG_HIGH_RES_TIMERS=y
CONFIG_PREEMPT=y
CONFIG_BLK_DEV_INITRD=y
# CONFIG_RD_GZIP is not set
# CONFIG_RD_BZIP2 is not set
# CONFIG_RD_LZMA is not set
# CONFIG_RD_XZ is not set
# CONFIG_RD_LZO is not set
# CONFIG_RD_LZ4 is not set
# CONFIG_POSIX_TIMERS is not set
# CONFIG_BUG is not set
# CONFIG_SHMEM is not set
CONFIG_KALLSYMS_ALL=y
CONFIG_EMBEDDED=y
# CONFIG_VM_EVENT_COUNTERS is not set
# CONFIG_SLUB_DEBUG is not set
# CONFIG_SLAB_MERGE_DEFAULT is not set
CONFIG_ARCH_TEGRA=y
# CONFIG_ARM64_ERRATUM_843419 is not set
# CONFIG_CAVIUM_ERRATUM_22375 is not set
# CONFIG_CAVIUM_ERRATUM_23154 is not set
# CONFIG_CAVIUM_ERRATUM_27456 is not set
# CONFIG_CAVIUM_ERRATUM_30115 is not set
# CONFIG_QCOM_FALKOR_ERRATUM_1003 is not set
# CONFIG_QCOM_FALKOR_ERRATUM_1009 is not set
# CONFIG_QCOM_QDF2400_ERRATUM_0065 is not set
# CONFIG_QCOM_FALKOR_ERRATUM_E1041 is not set
CONFIG_HZ_1000=y
# CONFIG_UNMAP_KERNEL_AT_EL0 is not set
CONFIG_COMPAT=y
CONFIG_ARMV8_DEPRECATED=y
CONFIG_SWP_EMULATION=y
CONFIG_CP15_BARRIER_EMULATION=y
CONFIG_SETEND_EMULATION=y
# CONFIG_ARM64_VHE is not set
CONFIG_RANDOMIZE_BASE=y
CONFIG_TEGRA_EBP=y
# CONFIG_EFI is not set
CONFIG_TEGRA_DTC_SUPPRESS_WARNINGS=y
CONFIG_ARCH_TEGRA_23x_SOC=y
# CONFIG_VMAP_STACK is not set
CONFIG_MODULES=y
# CONFIG_BLK_DEV_BSG is not set
# CONFIG_MQ_IOSCHED_DEADLINE is not set
# CONFIG_MQ_IOSCHED_KYBER is not set
# CONFIG_CORE_DUMP_DEFAULT_ELF_HEADERS is not set
CONFIG_KSM=y
CONFIG_CMA=y
CONFIG_NET=y
CONFIG_PACKET=y
CONFIG_INET=y
CONFIG_IP_MULTICAST=y
CONFIG_IP_PNP=y
CONFIG_IP_PNP_DHCP=y
# CONFIG_IPV6 is not set
CONFIG_BRIDGE=m
CONFIG_NET_DSA=m
CONFIG_NET_9P=y
CONFIG_PCI=y
CONFIG_PCIEPORTBUS=y
CONFIG_PCI_IOV=y
CONFIG_PCI_PASID=y
CONFIG_HOTPLUG_PCI=y
CONFIG_PCI_TEGRA=y
CONFIG_PCI_HOST_GENERIC=y
CONFIG_PCI_XGENE=y
CONFIG_PCIE_ALTERA=y
CONFIG_PCIE_ALTERA_MSI=y
CONFIG_PCI_HOST_THUNDER_PEM=y
CONFIG_PCI_HOST_THUNDER_ECAM=y
CONFIG_PCI_HISI=y
CONFIG_PCIE_KIRIN=y
CONFIG_PCIE_LAYERSCAPE_GEN4=y
CONFIG_PCI_ENDPOINT=y
CONFIG_PCI_ENDPOINT_CONFIGFS=y
CONFIG_DEVTMPFS=y
CONFIG_DEVTMPFS_MOUNT=y
CONFIG_FW_LOADER_USER_HELPER=y
CONFIG_NETDEVICES=y
CONFIG_AMD_XGBE=y
CONFIG_BCMGENET=m
CONFIG_TEGRA_HV_NET=y
# CONFIG_INPUT is not set
# CONFIG_SERIO is not set
# CONFIG_VT is not set
# CONFIG_UNIX98_PTYS is not set
# CONFIG_LEGACY_PTYS is not set
CONFIG_SERIAL_8250=y
CONFIG_SERIAL_8250_CONSOLE=y
CONFIG_SERIAL_OF_PLATFORM=y
CONFIG_SERIAL_TEGRA_TCU=y
CONFIG_TEGRA_HV_COMM=y
# CONFIG_HW_RANDOM is not set
# CONFIG_DEVMEM is not set
CONFIG_I2C=y
CONFIG_I2C_CHARDEV=y
CONFIG_I2C_MUX=y
# CONFIG_I2C_HELPER_AUTO is not set
CONFIG_I2C_TEGRA=y
# CONFIG_HWMON is not set
CONFIG_TRUSTY=y
CONFIG_WATCHDOG=y
CONFIG_WATCHDOG_CORE=y
# CONFIG_WATCHDOG_HANDLE_BOOT_ENABLED is not set
CONFIG_TEGRA_HV_WATCHDOG=y
CONFIG_MFD_MAX77620=y
CONFIG_REGULATOR=y
CONFIG_REGULATOR_FIXED_VOLTAGE=y
CONFIG_REGULATOR_GPIO=y
CONFIG_MEDIA_SUPPORT=y
CONFIG_VIDEO_DEV=m
# CONFIG_DVB_NET is not set
# CONFIG_MEDIA_TUNER_TDA18272 is not set
CONFIG_FB=y
CONFIG_TEGRA_GRHOST=y
# CONFIG_TEGRA_GRHOST_ISP is not set
# CONFIG_TEGRA_GRHOST_NVENC is not set
CONFIG_TEGRA_GR_VIRTUALIZATION=y
CONFIG_TEGRA_DC=y
CONFIG_TEGRA_DC_SCREEN_CAPTURE=y
CONFIG_TEGRA_HDMI2_0=y
CONFIG_TEGRA_HDMI2FPD_DS90UH949=y
CONFIG_TEGRA_NVMAP=y
CONFIG_NVMAP_CACHE_MAINT_BY_SET_WAYS=y
# CONFIG_USB_SUPPORT is not set
CONFIG_DMADEVICES=y
CONFIG_SYNC_FILE=y
# CONFIG_VIRTIO_MENU is not set
CONFIG_STAGING=y
CONFIG_TEGRA_BWMGR=y
CONFIG_TEGRA_ISOMGR=y
CONFIG_TEGRA_PM_DEBUG=y
# CONFIG_HISILICON_ERRATUM_161010101 is not set
# CONFIG_ARM64_ERRATUM_858921 is not set
CONFIG_ARM_SMMU=y
# CONFIG_ARM_SMMU_DISABLE_BYPASS_BY_DEFAULT is not set
CONFIG_ARCH_TEGRA_186_SOC=y
CONFIG_ARCH_TEGRA_194_SOC=y
CONFIG_TEGRA_FUSE_BURN=y
CONFIG_FIQ=y
CONFIG_TEGRA_HV_MANAGER=y
CONFIG_TEGRA_VIRTUALIZATION=y
# CONFIG_TEGRA_NVLINK is not set
# CONFIG_FILE_LOCKING is not set
# CONFIG_DNOTIFY is not set
# CONFIG_INOTIFY_USER is not set
# CONFIG_MISC_FILESYSTEMS is not set
# CONFIG_NETWORK_FILESYSTEMS is not set
CONFIG_CRYPTO=y
# CONFIG_CRYPTO_HW is not set
CONFIG_INDIRECT_PIO=y
CONFIG_DMA_CMA=y
CONFIG_CMA_SIZE_MBYTES=64
CONFIG_PRINTK_TIME=y
CONFIG_DEBUG_RODATA_TEST=y
CONFIG_PANIC_TIMEOUT=5
# CONFIG_SCHED_DEBUG is not set
# CONFIG_DEBUG_PREEMPT is not set
# CONFIG_FTRACE is not set
```

## drivers/Kconfig
```kconfig
append_menu "Device Drivers"

if ARCH_TEGRA
source "drivers/misc/tegra186-ahc/Kconfig"
source "drivers/nvpmodel/Kconfig"
source "drivers/iommu/Kconfig"
source "drivers/nvpps/Kconfig"
source "drivers/thermal/Kconfig"
source "drivers/trusty/Kconfig"
source "drivers/virt/tegra/Kconfig"
source "drivers/virt/ptp/Kconfig"
endif

endmenu
```
