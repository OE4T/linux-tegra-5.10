/*
 * tegra194-soc-eqos.dtsi: Ethernet QOS DTSI file.
 *
 * Copyright (c) 2017-2019, NVIDIA CORPORATION.  All rights reserved.
 *
 * This program is free software; you can redistribute it and/or modify
 * it under the terms of the GNU General Public License as published by
 * the Free Software Foundation; version 2 of the License.
 *
 * This program is distributed in the hope that it will be useful, but WITHOUT
 * ANY WARRANTY; without even the implied warranty of MERCHANTABILITY or
 * FITNESS FOR A PARTICULAR PURPOSE.  See the GNU General Public License for
 * more details.
 *
 * You should have received a copy of the GNU General Public License along
 * with this program; if not, write to the Free Software Foundation, Inc.,
 * 51 Franklin Street, Fifth Floor, Boston, MA  02110-1301, USA.
 *
 */

#include <dt-bindings/clock/tegra194-clock.h>
#include <dt-bindings/reset/tegra194-reset.h>

#define MAKE_EQOS_TRIP(name, temp, hyst) \
	eqos_##name: eqos-##name@temp { \
		temperature = <(temp)>; \
		hysteresis = <hyst>; \
		type = "active"; \
	}

#define MAP_EQOS(name, state) \
	map_eqos_##name { \
		trip = <&eqos_##name>; \
		cooling-device = <&eqos_cool_dev state state>; \
		cdev-type = "tegra-eqos"; \
	}


/ {
	aliases {
		ethernet = "/ethernet@2490000";
	};

	ethernet@2490000 {
		compatible = "nvidia,nveqos";
		reg = <0x0 0x02490000 0x0 0x10000>;    /* EQOS Base Register */
		interrupts = 	<0 194 0x4>,	/* common */
				<0 186 0x4>,	/* tx0 */
				<0 187 0x4>,	/* tx1 */
				<0 188 0x4>,	/* tx2 */
				<0 189 0x4>,	/* tx3 */
				<0 190 0x4>,	/* rx0 */
				<0 191 0x4>,	/* rx1 */
				<0 192 0x4>,	/* rx2 */
				<0 193 0x4>;	/* rx3 */
		clocks = <&bpmp_clks TEGRA194_CLK_PLLREFE_VCOOUT>,
			 <&bpmp_clks TEGRA194_CLK_EQOS_AXI>,
			 <&bpmp_clks TEGRA194_CLK_EQOS_RX>,
			 <&bpmp_clks TEGRA194_CLK_EQOS_PTP_REF>,
			 <&bpmp_clks TEGRA194_CLK_EQOS_TX>,
			 <&bpmp_clks TEGRA194_CLK_AXI_CBB>;
		clock-names = "pllrefe_vcoout", "eqos_axi", "eqos_rx", "eqos_ptp_ref", "eqos_tx", "axi_cbb";
		resets = <&bpmp_resets TEGRA194_RESET_EQOS>;
		reset-names = "mac_rst";
		nvidia,num-dma-chans = <4>;
		nvidia,dma-chans = <0 1 2 3>;
		nvidia,slot_num_check = <0x0 0x0 0x0 0x0>;
		nvidia,slot_intvl_vals = <0x0 0x7D 0x7D 0x7D>;
		nvidia,num-mtl-queues = <4>;
		nvidia,mtl-queues = <0 1 2 3>;
		nvidia,rx-queue-prio = <0x2 0x1 0x30 0x48>;
		nvidia,dcs-enable = <0x0>;
		nvidia,tx-queue-prio = <0x0 0x7 0x2 0x3>;
		iommus = <&smmu TEGRA_SID_EQOS>;
		iommu-resv-regions = <0x0 0x0 0x0 0x40000000 0x0 0x60000000 0xffffffff 0xffffffff>;
		iommu-group-id = <TEGRA_IOMMU_GROUP_APE>;
		dma-coherent;
		/* usec value for Rx watchdog interrupt */
		nvidia,rx_riwt = <512>;
		/* PTP_ref clock speed in Hz (312.5 MHz)*/
		nvidia,ptp_ref_clock_speed = <312500000>;
		nvidia,queue_prio = <0 1 2 3>;
		status = "disabled";
		eqos_cool_dev: eqos-cool-dev {
			cooling-min-state = <0>;
			cooling-max-state = <5>;
			#cooling-cells = <2>;
		};
	};

};
