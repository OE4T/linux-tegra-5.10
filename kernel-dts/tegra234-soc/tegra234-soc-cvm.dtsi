/*
 * Copyright (c) 2014-2021, NVIDIA CORPORATION.  All rights reserved.
 *
 * This program is free software; you can redistribute it and/or modify it
 * under the terms and conditions of the GNU General Public License,
 * version 2, as published by the Free Software Foundation.
 *
 * This program is distributed in the hope it will be useful, but WITHOUT
 * ANY WARRANTY; without even the implied warranty of MERCHANTABILITY or
 * FITNESS FOR A PARTICULAR PURPOSE.  See the GNU General Public License for
 * more details.
 *
 * You should have received a copy of the GNU General Public License
 * along with this program.  If not, see <http://www.gnu.org/licenses/>.
 *
 * tegrat234-soc-cvm.dtsi: CVM based platform common SoC specific DTSI file
 *			   with required node enabled.
 */

#include <tegra234-soc/tegra234-soc-base.dtsi>
#include <tegra234-soc/tegra234-cpus.dtsi>
#include <tegra234-soc/tegra234-soc-prod.dtsi>

/ {
};
